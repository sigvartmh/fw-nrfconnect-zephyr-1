## prj.conf
```kconfig
# nothing here
CONFIG_BOOTLOADER_MCUBOOT=y
CONFIG_FLASH=y
CONFIG_NORDIC_QSPI_NOR=y
CONFIG_NORDIC_QSPI_NOR_FLASH_LAYOUT_PAGE_SIZE=4096
CONFIG_ASSERT=y
CONFIG_FLASH=y
CONFIG_IMG_ERASE_PROGRESSIVELY=y
CONFIG_IMG_MANAGER=y
CONFIG_MPU_ALLOW_FLASH_WRITE=y
CONFIG_PM_EXTERNAL_FLASH=y
CONFIG_PM_EXTERNAL_FLASH_DEV_NAME="MX25R64"
#CONFIG_PM_EXTERNAL_FLASH_SIZE=0x10000
CONFIG_PM_EXTERNAL_FLASH_SIZE=0xf4000
CONFIG_PM_EXTERNAL_FLASH_BASE=0
CONFIG_LOG=y
# CONFIG_LOG_MINIMAL is not set
# CONFIG_LOG_RUNTIME_FILTERING is not set
CONFIG_LOG_OVERRIDE_LEVEL=0
CONFIG_LOG_MAX_LEVEL=4
# CONFIG_LOG_MIPI_SYST_ENABLE is not set
CONFIG_LOG_BACKEND_SHOW_COLOR=y
CONFIG_LOG_BACKEND_FORMAT_TIMESTAMP=y
CONFIG_LOG_FUNC_NAME_PREFIX_DBG=y

#
# Prepend log message with function name
#
# CONFIG_LOG_FUNC_NAME_PREFIX_ERR is not set
# CONFIG_LOG_FUNC_NAME_PREFIX_WRN is not set
# CONFIG_LOG_FUNC_NAME_PREFIX_INF is not set
CONFIG_LOG_FUNC_NAME_PREFIX_DBG=y
# end of Prepend log message with function name

CONFIG_LOG_PRINTK=y
CONFIG_LOG_IMMEDIATE=y
# CONFIG_LOG_IMMEDIATE_CLEAN_OUTPUT is not set
# CONFIG_LOG_ENABLE_FANCY_OUTPUT_FORMATTING is not set
CONFIG_LOG_DOMAIN_ID=0
# CONFIG_LOG_FRONTEND is not set
CONFIG_LOG_BACKEND_UART=y
```

## src/main.c
```c
/*
 * Copyright (c) 2012-2014 Wind River Systems, Inc.
 *
 * SPDX-License-Identifier: Apache-2.0
 */

#include <zephyr.h>
#include <sys/printk.h>
#include <app_update.h>
#include <dfu/flash_img.h>
#include <dfu/mcuboot.h>

void main(void)
{
	struct flash_img_context flash_img;
	printk("Hello World! %s upgrader sample\n", CONFIG_BOARD);
	int err = flash_img_init(&flash_img);
	if (err != 0) {
		__ASSERT(true, "flash_img_init error %d", err);
	}

	printk("Writing app to external flash\n");
	err = flash_img_buffered_write(&flash_img, (u8_t *)app_update_bin, app_update_bin_len, false);
	if (err != 0) {
		__ASSERT(true, "flash_img_buffered_write error %d", err);
	}

	err = flash_img_buffered_write(&flash_img, NULL, 0, true);
	if (err != 0) {
		__ASSERT(true, "flash_img_buffered_write error %d", err);
	}

	err = boot_request_upgrade(BOOT_UPGRADE_TEST);
	if (err != 0) {
		__ASSERT(true, "reguest upgrade failed %d", err);
	}

	printk("Upgrade done\n");

}
```
